## demo/components/demo_component/Kconfig
```kconfig
config MODULE_DEMO_COMPONENT_ENABLE
    bool "Enable demo component"
    default n
    help
      Enable demo component.
```

## demo/demo_project/src/main/Kconfig
```kconfig
config MODULE_MAIN_ENABLE
    bool "main app enalbe"
    default y
    help
      Enable main app.
```

## demo/src/demo_app/Kconfig
```kconfig
config MODULE_DEMO_APP_ENABLE
    bool "Enable demo app"
    default y
    help
      Enable demo app.
    select MODULE_DEMO_COMPONENT_ENABLE
```
